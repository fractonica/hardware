## firmware/apps/hwprobe/main/Kconfig.projbuild
```kconfig
menu "Fractonica hwprobe"

    config HWPROBE_WIFI_SSID
        string "Wi-Fi SSID (empty = skip Wi-Fi tests)"
        default ""
        help
            Pass via a git-ignored defaults file, never commit credentials.

    config HWPROBE_WIFI_PASS
        string "Wi-Fi password"
        default ""

    config HWPROBE_HUB_HOST
        string "Hub mDNS host name (without .local)"
        default "dimas-3"

    config HWPROBE_HUB_IP
        string "Hub IPv4 fallback if mDNS fails"
        default ""

    config HWPROBE_HUB_PORT
        int "Hub echo port (TCP and UDP)"
        default 7421

    config HWPROBE_OLED_SDA
        int "OLED SDA GPIO"
        default 5

    config HWPROBE_OLED_SCL
        int "OLED SCL GPIO"
        default 6

    config HWPROBE_LED_GPIO
        int "Status LED GPIO"
        default 8

    config HWPROBE_BUTTON_GPIO
        int "BOOT button GPIO"
        default 9

endmenu
```

## firmware/components/fr_caps/Kconfig
```kconfig
menu "Fractonica capabilities"

    config FR_TEST_HOOKS
        bool "Test hooks (inject commands, diag call)"
        default n
        help
            Compiles capability commands with `visibility: test` (fr.button inject, ...) and the
            diag `call`/`inject` JSON codecs. Set by sdkconfig.build.debug; never on in release
            builds, where those commands answer UNSUPPORTED.

endmenu
```

## firmware/components/fr_core/Kconfig
```kconfig
menu "Fractonica core"

    config FR_TEST_PIN
        int "T-LAT test pin (-1 = none)"
        range -1 48
        default -1
        help
            The board manifest's test_pin (spec 04 §4.3), written into sdkconfig.board by `fr gen firmware`,
            which checks that it is a free pin no instance claims. Debug builds (FR_TEST_HOOKS) drive it
            open-drain for diag `pin_pulse <us>` (design c6 D24): released at idle, low during a pulse, never
            pushed high, since the T-LAT rig wires it to another board's BOOT pin, a strapping pin that must
            read high whenever that board resets.

    config FR_ROLE
        int "HELLO role (0 node, 1 gateway, 2 fixture)"
        range 0 2
        default 0
        help
            The PRESENCE.HELLO role (schema/protocol.yaml Role, spec 05 §5.7), set from the profile's role by
            `fr gen firmware`. The HIL fixture's profile sets 2 (design m2-c1-hil D6): the hub keeps a fixture
            out of `all`, fences it from clients and never shows it to apps.

    config FR_CORE_TASK_STACK
        int "Core task stack (bytes)"
        range 8192 32768
        default 8192
        help
            The fr_core task's stack. Every dispatch runs on it, a bulk Reply (1445 B) and fr.diag exec's cJSON
            included. `fr gen firmware` raises it in sdkconfig.board for a profile with an fr.display instance
            (design m2-c5-display D3): the generated fr.display dispatch decodes a ui_load layout (24 widgets, about
            1.7 KB per copy) in nested copies before the service sees it, on any panel (a mono one answers
            UNSUPPORTED only after the decode).

    # fr.csi (design csi-c1 D10, §12): CsiService's buffers, internal RAM. A profile's `memory: small` has
    # `fr gen firmware` lower them in sdkconfig.board.

    config FR_CSI_RING_BYTES
        int "CSI record ring (bytes, a power of two)"
        range 2048 32768
        default 8192
        help
            Records on their way from the Wi-Fi task to fr_stream, allocated at init: 8 KB holds about 60 LLTF or
            16 HE20 records (0.15-0.6 s at 100 Hz). A power of two (2048, 4096, 8192, 16384, 32768; CsiService
            static_asserts it): the ring's byte counters run free and wrap at 2^32.

    config FR_CSI_BLOCK_BYTES
        int "CSI stream block buffer (bytes, each of two)"
        range 2048 8192
        default 8192
        help
            A stream block's buffer, at most csi::kBlockMaxBytes (the hub takes any size up to it). Both come from
            the heap while a stream runs and go back at its end.

    config FR_CORE_TASK_WDT
        bool "Watch the core task with the task watchdog"
        depends on ESP_TASK_WDT_INIT
        default y if ESP_TASK_WDT_PANIC
        help
            The core task subscribes to the task watchdog and feeds it from its loop, whose idle wait then lasts
            at most 1 s, so a callback that blocks (or spins) past CONFIG_ESP_TASK_WDT_TIMEOUT_S trips it, not
            only an idle task it starves. On by default exactly when a timeout panics and reboots
            (CONFIG_ESP_TASK_WDT_PANIC): the HIL fixture's fixture_gpio driver sets that (design m2-c1-hil D11
            item 1), so a wedged fixture reboots with every line let go instead of sitting offline. Off, a
            timeout only logs, as on every other profile.

endmenu
```

## firmware/components/fr_id/Kconfig
```kconfig
menu "Fractonica identity"

    config FR_BOARD
        string "Board id"
        default "unknown"
        help
            Set by the generated board fragment (sdkconfig.board), never by hand.

    config FR_PROFILE
        string "Profile"
        default "unknown"
        help
            Set by the generated board fragment (sdkconfig.board), never by hand.

    config FR_PART_PROFILE
        string "Partition profile"
        default "unknown"
        help
            Set by the generated board fragment (sdkconfig.board), never by hand.

endmenu
```

## firmware/components/fr_net/Kconfig
```kconfig
menu "Fractonica network"

    # Presence and delivery (spec 05 §5.17, design c3 §6). fr_core maps these into fr::net::Config.

    config FR_HEARTBEAT_MS
        int "Heartbeat interval to the hub (ms)"
        range 100 60000
        default 1000
        help
            PRESENCE/HEARTBEAT cadence (+-10 % jitter); the `game` link profile uses 250.

    config FR_SUSPECT_X10
        int "Suspect after (heartbeat intervals x10)"
        range 10 100
        default 25
        help
            The hub marks a silent node suspect (and PINGs it) after this many tenths of an interval.

    config FR_OFFLINE_X10
        int "Offline / hub lost after (heartbeat intervals x10)"
        range 10 200
        default 35
        help
            The hub declares a silent node offline, and the node declares the hub lost (closes and
            reconnects TCP), after this many tenths of a heartbeat interval.

    config FR_OFFLINE_MIN_MS
        int "Offline floor (ms)"
        range 0 60000
        default 750

    config FR_HELLO_RETRY_MS
        int "HELLO repeat until WELCOME (ms)"
        range 100 60000
        default 1000

    config FR_ACK_BASE_MS
        int "First Q1 retry on UDP (ms)"
        range 5 1000
        default 20
        help
            Then x2 backoff with +-25 % jitter, up to FR_MAX_ATTEMPTS attempts with the same seq.

    config FR_MAX_ATTEMPTS
        int "Q1 attempts on UDP"
        range 1 16
        default 4

    config FR_EVENT_MAX_AGE_MS
        int "Q1 event max age at send time (ms)"
        range 100 60000
        default 1000
        help
            Older Q1 events are dropped and counted, so stale input never reaches a game (node.boot
            is exempt).

    config FR_CMD_EXPIRE_MS
        int "Hub command expiry (ms)"
        range 100 60000
        default 1000
        help
            How far ahead of its send time the hub sets a CMD's expire_at_us. The hub applies it; the
            node only honours the EXT TLV.

    config FR_TCP_DELIVERY_MS
        int "TCP delivery give-up (ms)"
        range 100 60000
        default 2000

    config FR_TTL_DEFAULT
        int "Initial TTL"
        range 1 7
        default 2

    # ESP-NOW, node <-> node and managed flooding (spec 05 §5.9-5.10, §5.17, design c5 §7).

    config FR_TTL_MAX
        int "Largest TTL accepted"
        range 1 15
        default 7
        help
            A received frame claiming a larger initial TTL is dropped.

    config FR_ACK_PER_HOP_MS
        int "Q1 retry allowance per ESP-NOW hop (ms)"
        range 0 1000
        default 10
        help
            A reliable node -> node frame waits FR_ACK_BASE_MS plus this per expected hop for its RESULT
            or ACK before the next end-to-end attempt.

    config FR_ESPNOW_HB_MS
        int "ESP-NOW heartbeat interval (ms)"
        range 1000 60000
        default 5000
        help
            Router mode: PRESENCE/HEARTBEAT to the broadcast MAC (+-20 %, TTL 1, never relayed), from
            which neighbours learn this node.

    config FR_RELAY_JMIN_MS
        int "Flood relay delay, minimum (ms)"
        range 0 1000
        default 1

    config FR_RELAY_JMAX_MS
        int "Flood relay delay, maximum (ms)"
        range 1 1000
        default 16
        help
            A relay waits uniform(FR_RELAY_JMIN_MS, FR_RELAY_JMAX_MS) plus an RSSI bias (strong signal,
            longer wait), so the farthest neighbour tends to relay first.

    config FR_RELAY_K
        int "Copies heard that cancel a pending relay"
        range 1 8
        default 2

    config FR_HUB_PORT
        int "Hub TCP and UDP port"
        range 1 65535
        default 7421

    # The radio (design m2-c1-hil D5, D6): off on the HIL fixture's profile (`net: {radio: off}`).

    config FR_NET_RADIO
        bool "Wi-Fi and ESP-NOW"
        default y
        help
            Set from the profile's net.radio by `fr gen firmware` (n for `radio: off`). Off, fr_core never
            starts Wi-Fi or ESP-NOW and attaches only the serial link: the hub is reached over USB alone, the
            serial session's WELCOME sets the NET health bit of an image on probation (spec 06 §6.6) in place
            of Wi-Fi, HELLO never says `wifi` or `espnow_v2`, and fr.node.net_set and `net wifi_down` answer
            UNSUPPORTED. The image is updated over USB only (flash_start).

    config FR_WIFI_MAX_TX_POWER_QDBM
        int "Wi-Fi TX power cap, 0.25 dBm units (0 = driver default)"
        default 0
        range 0 84
        help
            Set from the board manifest's rf.max_tx_power_qdbm by `fr gen firmware` (spec 05 §5.3). Some
            boards' antennas fail authentication at full power; the C3 0.42" OLED board needs 34 (8.5 dBm).

    # Development fallback for UNASSIGNED nodes (spec 06 §6.4 "Adopting foreign devices"). Set them only in
    # the git-ignored firmware/config/sdkconfig.local; they are compiled into that build's image.

    config FR_DEV_WIFI_SSID
        string "Dev Wi-Fi SSID (UNASSIGNED nodes only)"
        default ""
        help
            Used when fr_ident carries no network. Empty: such a node does not join Wi-Fi.

    config FR_DEV_WIFI_PASS
        string "Dev Wi-Fi password (UNASSIGNED nodes only)"
        default ""

    config FR_DEV_HUB_HOST
        string "Dev hub host (UNASSIGNED nodes only)"
        default ""
        help
            `<LocalHostName>.local` or an IPv4 address, used with the dev Wi-Fi credentials.

endmenu
```

## firmware/components/fr_ota/Kconfig
```kconfig
menu "Fractonica OTA"

    config FR_TEST_FAULT_HEALTH
        bool "Fault build: never pass the OTA health check"
        default n
        depends on FR_TEST_HOOKS
        help
            A fault build (spec 03 §3.8): the image never sets the CAPS health bit, so after an OTA
            its 60 s health deadline rolls it back (T-OTA). Set only by `fr build --fault health`,
            through the generated layer fr_gen/sdkconfig.fault; fr_app_desc reports it (fault = 1)
            and the hub never picks such a build implicitly. Debug builds only.

endmenu
```

## hosts/rpi3/br2-external/Config.in
```kconfig
menu "raphael: Raspberry Pi 3 support"
	source "$BR2_EXTERNAL_RPI3_PATH/package/rpi-kernel-bin/Config.in"
endmenu
```

## hosts/rpi3/br2-external/package/rpi-kernel-bin/Config.in
```kconfig
config BR2_PACKAGE_RPI_KERNEL_BIN
	bool "rpi-kernel-bin"
	depends on BR2_PACKAGE_RPI_FIRMWARE
	help
	  Raspberry Pi's own 64-bit kernel (kernel8.img), the Pi 3 Model B and B+ device trees and the
	  matching modules, taken from the firmware repository that rpi-firmware already downloads, instead
	  of building a kernel. The kernel version follows the firmware version Buildroot pins.
```

## hosts/uno-q/br2-external/Config.in
```kconfig
menu "qonu: Arduino UNO Q support"
	source "$BR2_EXTERNAL_QONU_PATH/package/qrtr/Config.in"
	source "$BR2_EXTERNAL_QONU_PATH/package/rmtfs/Config.in"
	source "$BR2_EXTERNAL_QONU_PATH/package/tqftpserv/Config.in"
	source "$BR2_EXTERNAL_QONU_PATH/package/qbootctl/Config.in"
	source "$BR2_EXTERNAL_QONU_PATH/package/uno-q-firmware/Config.in"
	source "$BR2_EXTERNAL_QONU_PATH/package/uno-q-openocd/Config.in"
	source "$BR2_EXTERNAL_QONU_PATH/package/qonu-link/Config.in"
	source "$BR2_EXTERNAL_QONU_PATH/package/qonu-node/Config.in"
	source "$BR2_EXTERNAL_QONU_PATH/package/node-official/Config.in"
endmenu
```

## hosts/uno-q/br2-external/package/node-official/Config.in
```kconfig
config BR2_PACKAGE_NODE_OFFICIAL
	bool "node-official"
	depends on BR2_aarch64
	depends on BR2_TOOLCHAIN_USES_GLIBC
	depends on BR2_INSTALL_LIBSTDCPP
	help
	  Node.js from nodejs.org's prebuilt linux-arm64 release
	  (Buildroot's own nodejs is 22.x; the Fractonica hub needs
	  >= 24.12). Installs /usr/bin/node and npm/npx, for the hub
	  and the apps deployed to the board.
```

## hosts/uno-q/br2-external/package/qbootctl/Config.in
```kconfig
config BR2_PACKAGE_QBOOTCTL
	bool "qbootctl"
	help
	  Qualcomm A/B boot slot control. `qbootctl -m` marks the
	  current slot as successfully booted; without it the UNO Q's
	  ABL switches slots or stops in fastboot after a few boots.

	  https://github.com/linux-msm/qbootctl
```

## hosts/uno-q/br2-external/package/qonu-link/Config.in
```kconfig
config BR2_PACKAGE_QONU_LINK
	bool "qonu-link"
	depends on BR2_aarch64
	help
	  The qonu link between Linux and the UNO Q's STM32U585:
	  /usr/bin/qonu-link (daemon + CLI) and the matching MCU
	  firmware at /usr/share/qonu/mcu/qonu-fw.elf. Built from
	  link/ in this repository with the Rust toolchain pinned in
	  docker/Dockerfile, using the committed Cargo.lock files.
```

## hosts/uno-q/br2-external/package/qonu-node/Config.in
```kconfig
config BR2_PACKAGE_QONU_NODE
	bool "qonu-node"
	depends on BR2_aarch64
	depends on BR2_INSTALL_LIBSTDCPP
	depends on BR2_TOOLCHAIN_HAS_THREADS
	depends on BR2_PACKAGE_QONU_LINK
	help
	  The UNO Q as a Fractonica device: /usr/bin/qonu-node runs
	  Fractonica's node runtime (fr_posix) and offers the STM32's
	  LED3 and LED matrix to the hub through qonu-link. Built from
	  hosts/uno-q/node against the Fractonica checkout, which the
	  builder mounts at /fr.
```

## hosts/uno-q/br2-external/package/qrtr/Config.in
```kconfig
config BR2_PACKAGE_QRTR
	bool "qrtr"
	help
	  Library and tools for the Qualcomm IPC Router (QRTR), used to
	  talk to the modem/ADSP remote processors.

	  https://github.com/linux-msm/qrtr
```

## hosts/uno-q/br2-external/package/rmtfs/Config.in
```kconfig
config BR2_PACKAGE_RMTFS
	bool "rmtfs"
	depends on BR2_PACKAGE_HAS_UDEV
	select BR2_PACKAGE_QRTR
	help
	  Qualcomm remote filesystem service. Serves the modem's
	  storage partitions (modemst1/2, fsg, fsc) and starts the
	  modem DSP, which runs the Wi-Fi firmware on the UNO Q.

	  https://github.com/linux-msm/rmtfs

comment "rmtfs needs udev"
	depends on !BR2_PACKAGE_HAS_UDEV
```

## hosts/uno-q/br2-external/package/tqftpserv/Config.in
```kconfig
config BR2_PACKAGE_TQFTPSERV
	bool "tqftpserv"
	select BR2_PACKAGE_QRTR
	help
	  TFTP server over QRTR. The modem DSP fetches the Wi-Fi
	  firmware through it while booting.

	  https://github.com/linux-msm/tqftpserv
```
