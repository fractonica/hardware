## hosts/uno-q/br2-external/package/uno-q-firmware/Config.in
```kconfig
config BR2_PACKAGE_UNO_Q_FIRMWARE
	bool "uno-q-firmware"
	select BR2_PACKAGE_LINUX_FIRMWARE
	help
	  Installs the subset of linux-firmware the UNO Q needs:
	  modem DSP (runs Wi-Fi), ath10k WCN3990 Wi-Fi, WCN3988
	  Bluetooth, ADSP and the Adreno 702 GPU microcode.
	  linux-firmware's own options do not cover these files.
```

## hosts/uno-q/br2-external/package/uno-q-openocd/Config.in
```kconfig
config BR2_PACKAGE_UNO_Q_OPENOCD
	bool "uno-q-openocd"
	depends on BR2_PACKAGE_LIBGPIOD2
	select BR2_PACKAGE_JIMTCL
	help
	  OpenOCD built from a pinned upstream commit, for flashing and
	  debugging the UNO Q's STM32U585 over SWD bit-banged on the
	  QRB2210's GPIOs. Buildroot's OpenOCD 0.12.0 only supports
	  libgpiod v1; upstream master supports libgpiod v2. Only the
	  linuxgpiod adapter is built.

	  https://openocd.org
```
